/dts-v1/;

#include "kona-v2.dtsi"

/ {
	model = "Qualcomm Technologies, Inc. kona v2 SoC";
	compatible = "qcom,kona";
	qcom,board-id = <0 0>;
	oppo,dtsi_no = <19161>;
	oppo,pcb_range = <4 8>;  /*T0 <= PCB < EVT1*/
};
